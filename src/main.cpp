#include <Arduino.h>
#include <WiFi.h>
#include <HTTPClient.h>
#include <NTPClient.h>
#include <ArduinoJson.h>
#include <Adafruit_SHT31.h>
#include <Wire.h>
#include <Adafruit_GFX.h>
#include <SPI.h>
#include <Adafruit_ILI9341.h>

// 'snow', 80x80px
const unsigned char epd_bitmap_snow[] PROGMEM = {
    0xff, 0xff, 0xff, 0xff, 0xff, 0xff, 0xff, 0xff, 0xff, 0xff, 0xff, 0xff, 0xff, 0xff, 0xff, 0xff,
    0xff, 0xff, 0xff, 0xff, 0xff, 0xff, 0xff, 0xff, 0xff, 0xff, 0xff, 0xff, 0xff, 0xff, 0xff, 0xff,
    0xff, 0xff, 0xff, 0xff, 0xff, 0xff, 0xff, 0xff, 0xff, 0xff, 0xff, 0xff, 0xff, 0xff, 0xff, 0xff,
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    0x00, 0x00, 0x00, 0x00, 0x00, 0x00, 0x00, 0x00, 0x00, 0x00, 0x00, 0x00, 0x00, 0x00, 0x00, 0x00};
// 'rain', 80x80px
const unsigned char epd_bitmap_rain[] PROGMEM = {
    0xff, 0xff, 0xff, 0xff, 0xff, 0xff, 0xff, 0xff, 0xff, 0xff, 0xff, 0xff, 0xff, 0xff, 0xff, 0xff,
    0xff, 0xff, 0xff, 0xff, 0xff, 0xff, 0xff, 0xff, 0xff, 0xff, 0xff, 0xff, 0xff, 0xff, 0xff, 0xff,
    0xff, 0xff, 0xff, 0xff, 0xff, 0xff, 0xff, 0xff, 0xff, 0xff, 0xff, 0xff, 0xff, 0xff, 0xff, 0xff,
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    0xff, 0xff, 0xff, 0xff, 0xff, 0xff, 0xff, 0xff, 0xff, 0xff, 0xff, 0xff, 0xff, 0xff, 0xff, 0xff};
// 'thunder', 80x80px
const unsigned char epd_bitmap_thunder[] PROGMEM = {
    0xff, 0xff, 0xff, 0xff, 0xff, 0xff, 0xff, 0xff, 0xff, 0xff, 0xff, 0xff, 0xff, 0xff, 0xff, 0xff,
    0xff, 0xff, 0xff, 0xff, 0xff, 0xff, 0xff, 0xff, 0xff, 0xff, 0xff, 0xff, 0xff, 0xff, 0xff, 0xff,
    0xff, 0xff, 0xff, 0xff, 0xff, 0xff, 0xff, 0xff, 0xff, 0xff, 0xff, 0xff, 0xff, 0xff, 0xff, 0xff,
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    0xff, 0xff, 0xff, 0xff, 0xff, 0xff, 0xff, 0xff, 0xff, 0xff, 0xff, 0xff, 0xff, 0xff, 0xff, 0xff};
// 'clear:cloudy', 80x80px
const unsigned char epd_bitmap_clear_cloudy[] PROGMEM = {
    0xff, 0xff, 0xff, 0xff, 0xff, 0xff, 0xff, 0xff, 0xff, 0xff, 0xff, 0xff, 0xff, 0xff, 0xff, 0xff,
    0xff, 0xff, 0xff, 0xff, 0xff, 0xff, 0xff, 0xff, 0xff, 0xff, 0xff, 0xff, 0xff, 0xff, 0xff, 0xff,
    0xff, 0xff, 0xff, 0xff, 0xff, 0xff, 0xff, 0xff, 0xff, 0xff, 0xff, 0xff, 0xff, 0xff, 0xff, 0xff,
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    0xff, 0xff, 0xff, 0xff, 0xff, 0xff, 0xff, 0xff, 0xff, 0xff, 0xff, 0xff, 0xff, 0xff, 0xff, 0xff};
// 'sun', 80x80px
const unsigned char epd_bitmap_sun[] PROGMEM = {
    0xff, 0xff, 0xff, 0xff, 0xff, 0xff, 0xff, 0xff, 0xff, 0xff, 0xff, 0xff, 0xff, 0xff, 0xff, 0xff,
    0xff, 0xff, 0xff, 0xff, 0xff, 0xff, 0xff, 0xff, 0xff, 0xff, 0xff, 0xff, 0xff, 0xff, 0xff, 0xff,
    0xff, 0xff, 0xff, 0xff, 0xff, 0xff, 0xff, 0xff, 0xff, 0xff, 0xff, 0xff, 0xff, 0xff, 0xff, 0xff,
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    0x00, 0x00, 0x00, 0x00, 0x00, 0x00, 0x00, 0x00, 0x00, 0x00, 0x00, 0x00, 0x00, 0x00, 0x00, 0x00};

#define button_pin 10
#define ss_pin 7
#define dc_pin 3
#define rst_pin 2

int previous_state = HIGH;
int button_state;
int counter = 0;
int last_screen = -5;

String latitude = "40.4259";
String longitude = "-86.9081";
int y;

const char *ssid = "xyz";
const char *password = "xyz";

String api_key = "xyz";

String daily_path =
    "https://api.openweathermap.org/data/4.0/onecall/timeline/1day"
    "?lat=" +
    latitude +
    "&lon=" + longitude +
    "&units=imperial"
    "&appid=" +
    api_key;

String hourly_path =
    "https://api.openweathermap.org/data/4.0/onecall/timeline/1h"
    "?lat=" +
    latitude +
    "&lon=" + longitude +
    "&units=imperial"
    "&appid=" +
    api_key;

WiFiUDP ntp;
NTPClient timeClient(ntp, "pool.ntp.org");
HTTPClient http;

JsonDocument doc;

Adafruit_ILI9341 tft(ss_pin, dc_pin, rst_pin);

Adafruit_SHT31 sht = Adafruit_SHT31();

int offset = -14400;
int code;

String api_time;
String sht_time;

bool sht_status;
bool update;

double temp;
double humidity;
double feels_temp;
double min_temp;
double max_temp;
double wind_speed;
String condition;
int condition_code;

unsigned long daily_api_millis = 0;
unsigned long sht_millis = 0;
unsigned long bounce_millis = 0;
unsigned long hourly_api_millis = 0;

double internal_temp;
double internal_humidity;

bool getDailyWeather();
bool getHourlyWeather();
String getTime();
void getInternalTemp();
void screen1();
void screen2();
void screen3();
void center(String, int);

void setup()
{
  Wire.begin(8, 9);
  Serial.begin(115200);
  WiFi.begin(ssid, password);

  Serial.print("Connecting");
  while (WiFi.status() != WL_CONNECTED)
  {
    Serial.print(".");
  }
  Serial.print("\nConnected!!!");

  timeClient.begin();
  timeClient.setTimeOffset(offset);

  tft.begin();

  sht_status = sht.begin(0x44);

  if (!sht_status)
  {
    Serial.println("SHT31 not connected");
  }

  tft.setTextSize(2);
  tft.fillScreen(ILI9341_DARKGREY);
  tft.setRotation(3);

  pinMode(button_pin, INPUT_PULLUP);

  Serial.println("Setup done.");
}

void loop()
{

  if (counter > 2)
  {
    counter = 0;
  }

  if (millis() - sht_millis > 300000 || sht_millis == 0)
  {

    getInternalTemp();
    sht_time = getTime();
    sht_millis = millis();
    update = true;
  }

  if (millis() - hourly_api_millis > 900000 || hourly_api_millis == 0)
  {

    if (getHourlyWeather())
    {
      api_time = getTime();
      update = true;
    }
    hourly_api_millis = millis();
  }

  if (millis() - daily_api_millis > 3600000 || daily_api_millis == 0)
  {
    Serial.println("Called weather");

    if (getDailyWeather())
    {
      api_time = getTime();
      update = true;
    }
    Serial.println("Left weather.");
    daily_api_millis = millis();
  }

  button_state = digitalRead(button_pin);

  if (button_state == LOW && previous_state == HIGH)
  {
    if (millis() - bounce_millis > 200)
    {
      bounce_millis = millis();
      counter++;
    }
  }

  previous_state = button_state;

  if (last_screen != counter || update)
  {
    if (counter == 0)
    {
      screen1();
    }
    else if (counter == 1)
    {
      screen2();
    }
    else if (counter == 2)
    {
      screen3();
    }
    last_screen = counter;
    update = false;
  }
}
String getTime()
{

  String noon;
  timeClient.update();
  int hours = timeClient.getHours();

  if (hours == 0)
  {
    noon = "AM";
    hours = 12;
  }
  else if (hours < 12)
  {
    noon = "AM";
  }
  else if (hours == 12)
  {
    noon = "PM";
  }
  else
  {
    noon = "PM";
    hours -= 12;
  }

  int minutes = timeClient.getMinutes();
  String string_minutes;

  if (minutes < 10)
  {
    string_minutes = "0" + String(minutes);
  }
  else
  {
    string_minutes = String(minutes);
  }

  return String(hours) + ":" + string_minutes + " " + noon;
}

bool getDailyWeather()
{
  String data;

  http.begin(daily_path);

  code = http.GET();
  data = http.getString();

  Serial.print("HTTP code: ");
  Serial.println(code);

  if (code < 200 || code >= 300)
  {
    http.end();
    return false;
  }
  DeserializationError error = deserializeJson(doc, data);

  Serial.println(data);

  if (error)
  {
    http.end();
    return false;
  }

  max_temp = doc["data"][0]["temp"]["max"];
  min_temp = doc["data"][0]["temp"]["min"];
  condition = doc["data"][0]["weather"][0]["main"].as<String>();
  condition_code = doc["data"][0]["weather"][0]["id"];

  http.end();
  return true;
}

bool getHourlyWeather()
{
  String data;

  http.begin(hourly_path);

  code = http.GET();
  data = http.getString();

  if (code < 200 || code >= 300)
  {
    http.end();
    return false;
  }

  DeserializationError error = deserializeJson(doc, data);

  if (error)
  {
    http.end();
    return false;
  }

  temp = doc["data"][0]["temp"];
  humidity = doc["data"][0]["humidity"];
  wind_speed = doc["data"][0]["wind_speed"];
  feels_temp = doc["data"][0]["feels_like"];

  http.end();
  return true;
}

void getInternalTemp()
{
  if (!sht_status)
  {
    return;
  }
  internal_temp = sht.readTemperature();
  internal_temp = internal_temp * 1.8 + 32;

  internal_humidity = sht.readHumidity();
}

void screen1()
{
  y = 0;

  tft.fillScreen(ILI9341_DARKGREY);
  center("Today's Weather!", y);
  y += 26;

  center("West Lafayette", y);
  y += 26;

  center("Temperature: " + String(temp) + " F", y);
  y += 26;

  center("High: " + String(max_temp) + " F", y);
  y += 26;

  center("Low: " + String(min_temp) + " F", y);
  y += 26;

  center("Feels like: " + String(feels_temp) + " F", y);
  y += 26;

  center("Humidity: " + String(humidity) + "%", y);
  y += 26;

  center("Wind Speed: " + String(wind_speed) + " MPH", y);

  center("Last Updated: " + api_time, 220);
}

void screen2()
{
  y = 0;
  tft.fillScreen(ILI9341_DARKGREY);

  center("Conditions: " + String(condition), y);

  center("Last Updated: " + api_time, 220);

  if (condition_code == 800)
  {
    tft.drawBitmap(
        120, // x
        80,  // y
        epd_bitmap_sun,
        80, // width
        80, // height
        ILI9341_YELLOW);
  }
  else if (condition_code >= 801 && condition_code <= 804)
  {
    tft.drawBitmap(
        120,
        80,
        epd_bitmap_clear_cloudy,
        80,
        80,
        ILI9341_LIGHTGREY);
  }
  else if (condition_code > 199 && condition_code < 300)
  {
    tft.drawBitmap(
        120, // x
        80,  // y
        epd_bitmap_thunder,
        80, // width
        80, // height
        ILI9341_LIGHTGREY);
  }
  else if ((condition_code > 299 && condition_code < 400) || (condition_code > 499 && condition_code < 600))
  {
    tft.drawBitmap(
        120, // x
        80,  // y
        epd_bitmap_rain,
        80, // width
        80, // height
        ILI9341_CYAN);
  }
  else if (condition_code > 599 && condition_code < 700)
  {
    tft.drawBitmap(
        120, // x
        80,  // y
        epd_bitmap_snow,
        80, // width
        80, // height
        ILI9341_LIGHTGREY);
  }
}

void screen3()
{

  y = 0;

  tft.fillScreen(ILI9341_DARKGREY);

  if (!sht_status)
  {
    center("SHT Not Connected.", y);
    return;
  }

  center("Inside Temp!", y);

  y += 26;

  center("Temperature: " + String(internal_temp) + " F", y);

  y += 26;

  center("Humidity: " + String(internal_humidity) + "%", y);

  center("Last Updated: " + sht_time, 220);
}

void center(String text, int y)
{
  int16_t x2, y2;
  uint16_t width, height;

  tft.getTextBounds(text, 0, y, &x2, &y2, &width, &height);

  int x = (tft.width() - width) / 2;

  tft.setCursor(x, y);
  tft.print(text);
}